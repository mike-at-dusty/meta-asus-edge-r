## conf/layer.conf
```bitbake
# We have a conf and classes directory, add to BBPATH
BBPATH .= ":${LAYERDIR}"

# We have recipes-* directories, add to BBFILES
BBFILES += "${LAYERDIR}/recipes-*/*/*.bb \
	${LAYERDIR}/recipes-*/*/*.bbappend"

BBFILE_COLLECTIONS += "meta-asus-edge-r"
BBFILE_PATTERN_meta-asus-edge-r = "^${LAYERDIR}/"
BBFILE_PRIORITY_meta-asus-edge-r = "9"

LAYERVERSION_meta-asus-edge-r = "1"
LAYERSERIES_COMPAT_meta-asus-edge-r = "dunfell"
```

## conf/machine/asus-edge-r.conf
```bitbake
#@TYPE: Machine
#@NAME: ASUS Tinker Board Edge R

PREFERRED_PROVIDER_virtual/kernel ?= "linux-asus-edge-r"
PREFERRED_PROVIDER_virtual/bootloader ?= "u-boot-asus-edge-r"

require conf/machine/include/rk3399.inc

KERNEL_DEVICETREE = "rockchip/rk3399pro-tinker_edge_r.dtb"
KBUILD_DEFCONFIG = "rockchip_linux_defconfig"

UBOOT_MACHINE = "tinker_edge_r_defconfig"

WKS_FILE = "asus-edge-r-gptdisk.wks.in"

RK_WIFIBT_FIRMWARES = " \
  brcm-tools \
"

MACHINE_EXTRA_RRECOMMENDS += " \
  linux-firmware-rk-cdndp \
  rockchip-npu \
  fancontrol \
"

MACHINE_ESSENTIAL_EXTRA_RRECOMMENDS += "\
  edge-r-firmware \
  resize-helper \
"
```

## conf/machine/rockchip-rk3399pro-tinker-board-edger.conf
```bitbake
#@TYPE: Machine
#@NAME: RK3399pro Tinker Edge R

PREFERRED_PROVIDER_virtual/kernel ?= "linux-tinker-board-edger"
PREFERRED_PROVIDER_virtual/bootloader ?= "u-boot-tinker-board-edger"

require conf/machine/include/rk3399.inc

KERNEL_DEVICETREE = "rockchip/rk3399pro-tinker_edge_r.dtb"
KBUILD_DEFCONFIG = "rockchip_linux_defconfig"

UBOOT_MACHINE = "tinker_edge_r_defconfig"

WKS_FILE = "tinker-board-edger-gptdisk.wks.in"

RK_WIFIBT_FIRMWARES = " \
  brcm-tools \
"

MACHINE_EXTRA_RRECOMMENDS += " \
  linux-firmware-rk-cdndp \
  rockchip-npu \
"

MACHINE_ESSENTIAL_EXTRA_RRECOMMENDS += "\
  edger-firmware \
  resize-helper \
"
```
